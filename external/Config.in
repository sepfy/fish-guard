## external/Config.in
```kconfig
source "../external/package/libpeer/Config.in"
source "../external/package/fish-guard/Config.in"
```

## external/package/fish-guard/Config.in
```kconfig
config BR2_PACKAGE_FISH_GUARD
	bool "fish-guard"
	depends on BR2_PACKAGE_LIBPEER
	help
	  fish guard app
```

## external/package/libpeer/Config.in
```kconfig
config BR2_PACKAGE_LIBPEER
	bool "libpeer"
	help
	  webrtc client sdk
	  https://github.com/sepfy/libpeer
```
